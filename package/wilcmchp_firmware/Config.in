## package/wilcmchp_firmware/Config.in
```kconfig
config BR2_PACKAGE_WILCMCHP_FIRMWARE
	bool "Microchip WILC devices firmware"
	help
	  Microchip WILC devices firmware files for use with Linux kernel.
```

## package/wildwest/Config.in
```kconfig
config BR2_PACKAGE_WILDWEST
	bool "Wildwest Qt Parallax App"
	depends on BR2_PACKAGE_QT5
	depends on BR2_PACKAGE_LIBPLANES
	help
	  Wildwest Qt 3D Parallax effect demo application.
```

## package/wireless-kit-pages/Config.in
```kconfig
config BR2_PACKAGE_WIRELESS_KIT_PAGES
	bool "Wireless credentials HTML pages"
	help
	  HTML pages to display when gateway IP address is accessed in the server.
```

## package/zephyr-sdk/Config.in.host
```kconfig
config BR2_PACKAGE_HOST_ZEPHYR_SDK
	bool "zephyr-sdk"
	depends on BR2_riscv
	depends on BR2_HOSTARCH = "x86_64" || BR2_HOSTARCH = "aarch64"
	help
	  Zephyr SDK
```

## system/Config.in
```kconfig
choice
	prompt "Init configuration"

config BR2_PACKAGE_PLANES_INIT
	bool "planes"
	depends on BR2_PACKAGE_LIBPLANES
	depends on BR2_PACKAGE_LIBPLANES_INSTALL_EXAMPLES
	help
	  Use the planes init script.

config BR2_PACKAGE_EGT_LAUNCHER_INIT
	bool "EGT Application Launcher"
	depends on BR2_PACKAGE_EGT_LAUNCHER
	help
	  Use the EGT application launcher init script.

config BR2_PACKAGE_INIT_NONE
	bool "none"

endchoice
```
