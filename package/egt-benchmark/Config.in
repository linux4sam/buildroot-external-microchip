## package/egt-benchmark/Config.in
```kconfig
config BR2_PACKAGE_EGT_BENCHMARK
	bool "egt benchmark"
	select BR2_PACKAGE_EGT
	help
	  EGT benchmark suite.
```

## package/egt-launcher/Config.in
```kconfig
config BR2_PACKAGE_EGT_LAUNCHER
	bool "egt launcher"
	select BR2_PACKAGE_EGT
	select BR2_PACKAGE_EVTEST
	help
	  This is a simple application launcher and sort of home menu.
```

## package/egt-media-extra/Config.in
```kconfig
config BR2_PACKAGE_EGT_MEDIA_EXTRA
	depends on BR2_PACKAGE_EGT
	bool "Download EGT Media extra files contains different decoder formats for video example applications"
	help
	  EGT media files for microchip sam9x and sama5 mpu's.
```

## package/egt-media/Config.in
```kconfig
config BR2_PACKAGE_EGT_MEDIA
	depends on BR2_PACKAGE_EGT
	bool "Download EGT Media files for example applications"
	help
	  EGT media files for microchip sam9x and sama5 mpu's.
```

## package/egt-samples-contribution/Config.in
```kconfig
config BR2_PACKAGE_EGT_SAMPLES_CONTRIBUTION
    bool "egt sample applications from the community"
    select BR2_PACKAGE_EGT
    help
      Various EGT sample applications made by the community.

if BR2_PACKAGE_EGT_SAMPLES_CONTRIBUTION
config BR2_PACKAGE_EGT_SAMPLES_CONTRIBUTION_SLIDERB
    bool "sliderb"
    default y
    help
      Slider with an interactive bump as the handle.
endif
```

## package/egt-samples/Config.in
```kconfig
config BR2_PACKAGE_EGT_SAMPLES
	bool "egt sample applications"
	select BR2_PACKAGE_EGT
	help
	  Various sample EGT applications.
```

## package/egt-thermostat/Config.in
```kconfig
config BR2_PACKAGE_EGT_THERMOSTAT
	bool "egt thermostat demo"
	select BR2_PACKAGE_EGT
	help
	  EGT thermostat demo application.
```

## package/egt/Config.in
```kconfig
config BR2_PACKAGE_EGT
	bool "egt graphics library"
	select BR2_PACKAGE_CAIRO
	depends on BR2_INSTALL_LIBSTDCPP
	depends on BR2_USE_WCHAR
	depends on BR2_TOOLCHAIN_GCC_AT_LEAST_5 # c++14
	help
	  EGT graphics library for microchip sam9x and sama5 mpu's.

comment "egt needs a toolchain w/ C++, gcc >= 5, wchar"
        depends on !BR2_INSTALL_LIBSTDCPP || \
                !BR2_TOOLCHAIN_GCC_AT_LEAST_5 || \
                !BR2_USE_WCHAR

if BR2_PACKAGE_EGT
config BR2_PACKAGE_EGT_MEDIA_SUPPORT
	bool "Compile with media support"
	default y
	select BR2_PACKAGE_GSTREAMER1
	select BR2_PACKAGE_GST1_PLUGINS_BASE
	select BR2_PACKAGE_GST1_PLUGINS_BASE_PLUGIN_ALSA
	select BR2_PACKAGE_GST1_PLUGINS_BASE_PLUGIN_APP
	select BR2_PACKAGE_GST1_PLUGINS_BASE_PLUGIN_AUDIOCONVERT
	select BR2_PACKAGE_GST1_PLUGINS_BASE_PLUGIN_AUDIORESAMPLE
	select BR2_PACKAGE_GST1_PLUGINS_BASE_PLUGIN_PLAYBACK
	select BR2_PACKAGE_GST1_PLUGINS_BASE_PLUGIN_VIDEOCONVERT
	select BR2_PACKAGE_GST1_PLUGINS_BASE_PLUGIN_VIDEOSCALE
	select BR2_PACKAGE_GST1_PLUGINS_BASE_PLUGIN_VOLUME
	select BR2_PACKAGE_GST1_PLUGINS_GOOD
	select BR2_PACKAGE_GST1_PLUGINS_GOOD_PLUGIN_ISOMP4
	select BR2_PACKAGE_GST1_LIBAV
	help
	  If unsure, say Y.

config BR2_PACKAGE_EGT_CHART_SUPPORT
	bool "Compile with chart support"
	default y
	select BR2_PACKAGE_PLPLOT
	select BR2_PACKAGE_PLPLOT_EXTCAIRO_DEVICE
	help
	  If unsure, say Y.

config BR2_PACKAGE_EGT_SVG_SUPPORT
	bool "Compile with SVG support"
	default y
	select BR2_PACKAGE_LIBRSVG
	help
	  If unsure, say Y.

config BR2_PACKAGE_EGT_FONTCONFIG_SUPPORT
        bool "Compile with Fontconfig support"
        default y
        select BR2_PACKAGE_FONTCONFIG
        help
          If unsure, say Y.

config BR2_PACKAGE_EGT_INSTALL_EXAMPLES
	bool "Compile and install examples"
	default y
	help
	  If unsure, say Y.

config BR2_PACKAGE_EGT_INSTALL_ICONS
	bool "Install icons"
	default y
	help
	  If unsure, say Y.

config BR2_PACKAGE_EGT_EXTRA_CONFIG_OPTIONS
	string "Additional egt configure options"
	default ""
	help
	Any additional egt configure options you may want to include.

endif
```

## package/g1-binaries/Config.in
```kconfig
config BR2_PACKAGE_G1_BINARIES
	bool "g1-binaries"
	depends on BR2_arm
	help
	  G1 binaries
```

## package/g1-decoder/Config.in
```kconfig
config BR2_PACKAGE_G1_DECODER
	bool "g1-decoder"
	depends on BR2_arm
	help
	  G1 video decoder for sama5d4 soc
```

## package/greengrass-core/Config.in
```kconfig
config BR2_PACKAGE_AWS_IOT_GREENGRASS_CORE
	bool "Download AWS IoT Greengrass Core Software"
	help
	  AWS IoT Greengrass seamlessly extends AWS to edge device so
	  they can act locally on the data they generate, while
	  still using the cloud for management, analytics, and durable
	  storage. With AWS IoT Greengrass, connected devices can run
	  AWS Lambda functions, Docker containers, or both,
	  execute predictions based on machine learning models, keep
	  device data in sync, and communicate with other devices
	  securely – even when not connected to the Internet.
```

## package/gst1-at91/Config.in
```kconfig
config BR2_PACKAGE_GST1_AT91
	bool "gst1-at91"
	depends on BR2_arm
	depends on !BR2_STATIC_LIBS
	select BR2_PACKAGE_GSTREAMER1
	select BR2_PACKAGE_GST1_PLUGINS_BASE
	select BR2_PACKAGE_G1_DECODER
	select BR2_PACKAGE_LIBDRM
	help
	  This is the gstreamer plugin for Microchip platforms
	  with a G1 hardware accelerated video decoder.

	  https://github.com/linux4sam/gst1-hantro-g1

comment "gst1-at91 needs a toolchain w/ dynamic library"
	depends on BR2_arm
	depends on BR2_STATIC_LIBS

comment "gst1-at91 needs a toolchain w/ glibc"
	depends on !BR2_TOOLCHAIN_USES_GLIBC
```

## package/homeautomation/Config.in
```kconfig
config BR2_PACKAGE_HOMEAUTOMATION
	bool "Home Automation"
	depends on BR2_PACKAGE_QT5
	depends on BR2_PACKAGE_LIBV4L
	help
	  Home automation demo.
```

## package/hss-payload-generator/Config.in.host
```kconfig
config BR2_PACKAGE_HOST_HSS_PAYLOAD_GENERATOR
	bool "HSS Payload Generator"
	help
	  Microchip PolarFire SoC Payload Generator

if BR2_PACKAGE_HOST_HSS_PAYLOAD_GENERATOR

config BR2_PACKAGE_HOST_HSS_PAYLOAD_GENERATOR_CFG
	string "Config file path and source location"
	help
	  Path to config.yaml file (including config.yaml)

config BR2_PACKAGE_HOST_HSS_PAYLOAD_GENERATOR_SRC
	string "Payload file path and binary location"
	help
	  Path to payload binary file (including file name)
	  Must match payload file name in config.yaml file
endif
```

## package/launcher/Config.in
```kconfig
config BR2_PACKAGE_LAUNCHER
	bool "Application Launcher"
	depends on BR2_PACKAGE_QT5
	help
	  Demo launcher application.
```

## package/libcamera-mchp/Config.in
```kconfig
config BR2_PACKAGE_LIBCAMERA_MCHP_ARCH_SUPPORTS
    bool
    default y
    # Invalid packing size of ControlValue struct on m68k
    depends on !BR2_m68k
    depends on !BR2_TOOLCHAIN_HAS_BINUTILS_BUG_27597

menuconfig BR2_PACKAGE_LIBCAMERA_MCHP
    bool "libcamera-mchp"
    depends on BR2_PACKAGE_LIBCAMERA_MCHP_ARCH_SUPPORTS
    depends on BR2_INSTALL_LIBSTDCPP
    depends on BR2_TOOLCHAIN_HAS_THREADS
    depends on BR2_TOOLCHAIN_GCC_AT_LEAST_8 # C++17
    depends on !BR2_STATIC_LIBS # gnutls
    depends on BR2_USE_WCHAR # gnutls
    select BR2_PACKAGE_GNUTLS
    select BR2_PACKAGE_LIBYAML
    select BR2_PACKAGE_LIBEVENT
    select BR2_PACKAGE_JPEG
    select BR2_PACKAGE_LIBPNG
    help
      Microchip's custom libcamera framework.

      https://github.com/linux4microchip/libcamera-mchp.git
if BR2_PACKAGE_LIBCAMERA_MCHP
config BR2_PACKAGE_LIBCAMERA_MCHP_IPA
    bool "libcamera-mchp IPA module"
    default y
    help
      Enable support for Microchip Image Sensor Controller (ISC)
      Image Processing Algorithm module.
endif

comment "libcamera-mchp needs a toolchain w/ C++, threads, wchar, dynamic library, gcc >= 8"
    depends on BR2_PACKAGE_LIBCAMERA_MCHP_ARCH_SUPPORTS
    depends on !BR2_INSTALL_LIBSTDCPP || !BR2_TOOLCHAIN_HAS_THREADS || \
        !BR2_TOOLCHAIN_GCC_AT_LEAST_8 || BR2_STATIC_LIBS || !BR2_USE_WCHAR
```

## package/libm2d/Config.in
```kconfig
comment "libm2d requires a GPU strategy"
	depends on BR2_MCHP_SAM_NO_GPU

config BR2_PACKAGE_LIBM2D
	bool "libm2d"
	depends on BR2_MCHP_SAM_HAS_GPU2D
	depends on !BR2_MCHP_SAM_NO_GPU
	select BR2_PACKAGE_LIBDRM if (BR2_MCHP_SAM_SAM9X6_GFX2D || BR2_MCHP_SAM_SAM9X7_GFX2D || BR2_MCHP_SAM_GC520UL_ETNAVIV)
	select BR2_PACKAGE_LIBDRM_ETNAVIV if BR2_MCHP_SAM_GC520UL_ETNAVIV
	select BR2_PACKAGE_NANO2D if BR2_MCHP_SAM_GC520UL_NANO2D
	help
	  libm2d is a library that provides the Multi 2D Graphics API.

if BR2_PACKAGE_LIBM2D
config BR2_PACKAGE_LIBM2D_TESTS
	bool "Build tests"
	default y
	help
	  If unsure, say Y.

endif
```

## package/libosmscout/Config.in
```kconfig
config BR2_PACKAGE_LIBOSMSCOUT
	bool "libosmscout"
	select BR2_PACKAGE_CAIRO
	select BR2_PACKAGE_PANGO
	select BR2_PACKAGE_LIBPNG
	select BR2_PACKAGE_LIBXML2
	help
	  Libosmscout is a C++ library for offline map rendering, routing and
	  location lookup based on OpenStreetMap data

	  https://github.com/Framstag/libosmscout
```

## package/libplanes/Config.in
```kconfig
config BR2_PACKAGE_LIBPLANES
	bool "libplanes"
	select BR2_PACKAGE_CAIRO
	select BR2_PACKAGE_CJSON
	select BR2_PACKAGE_LIBDRM
	select BR2_PACKAGE_LUA
	help
	  libplanes is a library that provides support for working with LCD
	  controller hardware planes found on SAM hardware.

if BR2_PACKAGE_LIBPLANES
config BR2_PACKAGE_LIBPLANES_ENGINE
	bool "Enable the engine"
	default y
	help
	  The engine parses json files and configure planes according to. It
	  is mostly used for demo purpose.
	  To use libplanes as a library only, unselect this option.
endif
```

## package/lohit-fonts/Config.in
```kconfig
config BR2_PACKAGE_LOHIT_FONTS
	bool "Lohit Indian languages fonts"
	help
	  Lohit is a font family designed to cover Indic scripts

	  https://github.com/lohit-fonts/lohit-fonts

if BR2_PACKAGE_LOHIT_FONTS

config BR2_PACKAGE_LOHIT_FONTS_FONTS
	string "List of fonts to install"
	default "devanagari"
	help
	  Specify a space-separated list of fonts to install. They
	  correspond to the directory of the font within lohit Font
	  directory code base. For example, devanagari, kannada.
endif
```

## package/mchpcam-apps/Config.in
```kconfig
config BR2_PACKAGE_MCHPCAM_APPS
	bool "mchpcam-apps"
	depends on BR2_PACKAGE_LIBCAMERA_MCHP
	help
	  Microchip camera applications including mchpcam-still
	  for libcamera-mchp.

	  https://github.com/linux4microchip/libcamera-mchp.git
```

## package/mgs/Config.in
```kconfig
config BR2_PACKAGE_MGS
	bool "Microchip Graphics Suite (MGS)"
	select BR2_PACKAGE_LIBDRM
	help
	  If unsure, say N.
```

## package/minehunt/Config.in
```kconfig
config BR2_PACKAGE_MINEHUNT
	bool "Mine Hunt Game"
	depends on BR2_PACKAGE_QT5
	depends on BR2_PACKAGE_QT5QUICK1D
	help
	  Mine Hunt game.
```

## package/mpfs_amp_examples/Config.in
```kconfig
config BR2_PACKAGE_MPFS_AMP_EXAMPLES
	bool "mpfs amp examples"
	help
	  Build Linux + FreeRTOS AMP example
	  for PolarFire SoC binary to be
	  included in the HSS payload.bin

config BR2_PACKAGE_MPFS_AMP_CONTEXT_B
	string "context_b_binary_name"
	help
	  Microchip PolarFire SoC AMP example project to run as context b
```

## package/mpfs_examples/Config.in
```kconfig
config BR2_PACKAGE_MPFS_EXAMPLES
    bool "mpfs_examples"
    depends on BR2_PACKAGE_LIBOPENSSL
    depends on BR2_PACKAGE_LIBGPIOD
    help
      Linux userspace examples for PolarFire SoC

if BR2_PACKAGE_MPFS_EXAMPLES
config BR2_PACKAGE_MPFS_EXAMPLES_DIRS
    string "MPFS example directories to install"
    default "can gpio system-services fpga-fabric-interfaces dma dt-overlays pdma gateware"
    help
      Space-separated list of example directories to install.

endif
```
