## package/nano2d/Config.in
```kconfig
config BR2_PACKAGE_NANO2D
	bool "nano2d"
	help
	  nano2d is a user-space library and kernel module that supports Vivante GCxxx 2D GPU.
```

## package/noto-fonts/Config.in
```kconfig
config BR2_PACKAGE_NOTO_FONTS
	bool "Google Noto fonts"
	help
	  Font files available from Google Noto Fonts

	  https://www.google.com/get/noto/

if BR2_PACKAGE_NOTO_FONTS

config BR2_PACKAGE_NOTO_FONTS_FONTS
	string "List of fonts to install"
	default "NotoSans-Regular.ttf"
	help
	  Specify a space-separated list of fonts to install. They
	  correspond to the filename of the font within Google
	  Font directory code base. For example, NotoSans-Regular.ttf,
	  NotoSansCJKsc-Regular.otf, or NotoColorEmoji.ttf.

endif
```

## package/pic64gx_amp_examples/Config.in
```kconfig
config BR2_PACKAGE_PIC64GX_AMP_EXAMPLES
	bool "pic64gx_amp_examples"
	select BR2_PACKAGE_HOST_PYTHON3
	select BR2_PACKAGE_HOST_PYTHON3_SSL
	select BR2_PACKAGE_HOST_ZEPHYR_SDK
	help
	  Build Linux + Zephyr AMP example
	  for PIC64GX SoC. Cannot be loaded from HSS
```

## package/pic64gx_amp_examples_hss/Config.in
```kconfig
config BR2_PACKAGE_PIC64GX_AMP_EXAMPLES_HSS
	bool "pic64gx_amp_examples_hss"
	select BR2_PACKAGE_HOST_PYTHON3
	select BR2_PACKAGE_HOST_PYTHON3_SSL
	select BR2_PACKAGE_HOST_ZEPHYR_SDK
	help
	  Build Linux + Zephyr AMP example
	  for PIC64GX SoC. The binary is to
	  be included in the HSS payload.bin
```

## package/pic64gx_examples/Config.in
```kconfig
config BR2_PACKAGE_PIC64GX_EXAMPLES
	bool "pic64gx_examples"
	help
	  Linux userspace examples for PIC64GX SoC
```

## package/plplot/Config.in
```kconfig
config BR2_PACKAGE_PLPLOT
	bool "plplot"
	help
	  PLplot is a cross-platform software package for creating scientific plots.

	  http://plplot.sourceforge.net/

if BR2_PACKAGE_PLPLOT
config BR2_PACKAGE_PLPLOT_EXTCAIRO_DEVICE
	bool "Compile with extcairo device support"
	default y
	select BR2_PACKAGE_CAIRO
	select BR2_PACKAGE_PANGO
	help
	  If unsure, say Y.
endif
```

## package/ptc_examples/Config.in
```kconfig
config BR2_PACKAGE_PTC_EXAMPLES
	bool "ptc_examples"
	select BR2_PACKAGE_LIBEVDEV
	select BR2_PACKAGE_LIBGPIOD
	help
	  Demo for PTC wings, it includes the PTC firmware and configuration
	  files.

config BR2_PACKAGE_PTC_EXAMPLES_PLATFORM
	depends on BR2_PACKAGE_PTC_EXAMPLES
	string "board name; default SAMA5D27_PTC_EK"
```

## package/python-cryptoauthlib/Config.in
```kconfig
config BR2_PACKAGE_PYTHON_CRYPTOAUTHLIB
	bool "python-cryptoauthlib"
	depends on BR2_PACKAGE_PYTHON3
	help
	  Python Cryptoauthlib library.

	  https://github.com/MicrochipTech/cryptoauthlib
```

## package/python-iocontrol/Config.in
```kconfig
config BR2_PACKAGE_PYTHON_IOCONTROL
	bool "python-iocontrol"
	depends on BR2_PACKAGE_PYTHON_PYQT5
	depends on BR2_PACKAGE_PYTHON_MPIO
	help
	  I/O Control Application.  This application is a graphical application
	  to analyze and manipulate hardware peripherals using the Microchip
	  Peripheral I/O (MPIO) package.

comment "python-iocontrol depends on pyqt5 and mpio"
	depends on !BR2_PACKAGE_PYTHON_PYQT5 || !BR2_PACKAGE_PYTHON_MPIO
```

## package/python-mpio/Config.in
```kconfig
config BR2_PACKAGE_PYTHON_MPIO
	bool "python-mpio"
	depends on BR2_PACKAGE_PYTHON || BR2_PACKAGE_PYTHON3
	help
	  Microchip Peripheral I/O.  A simple Python interface to hardware
	  peripherals found on Microchip boards and processors.

comment "python-mpio depends on python"
	depends on !BR2_PACKAGE_PYTHON && !BR2_PACKAGE_PYTHON3
```

## package/qt5quick1d/Config.in
```kconfig
config BR2_PACKAGE_QT5QUICK1D
	bool "qt5quick1d"
	select BR2_PACKAGE_QT5XMLPATTERNS
	select BR2_PACKAGE_QT5BASE
	select BR2_PACKAGE_QT5BASE_GUI
	depends on BR2_PACKAGE_QT5_VERSION_LATEST
	help
	  Qt is a cross-platform application and UI framework for
	  developers using C++.

	  Qt Quick 1 module provides the deprecated Qt Declarative
	  functionality.

	  This is postfixed with a "d" for deprecated.

	  http://doc.qt.io/qt-5/qtqml-index.html
	  http://doc.qt.io/qt-5/qtquick-index.html
```

## package/qtviewplanes/Config.in
```kconfig
config BR2_PACKAGE_QTVIEWPLANES
	bool "Plane View"
	depends on BR2_PACKAGE_QT5
	depends on BR2_PACKAGE_LIBPLANES
	help
	  Qt View Planes demo application.
```

## package/samegame/Config.in
```kconfig
config BR2_PACKAGE_SAMEGAME
	bool "Same Game"
	depends on BR2_PACKAGE_QT5
	depends on BR2_PACKAGE_QT5QUICK1D
	depends on BR2_PACKAGE_QT5DECLARATIVE
	help
	  Same Game demo.
```

## package/smartrefrigerator/Config.in
```kconfig
config BR2_PACKAGE_SMARTREFRIGERATOR
	bool "Smart Refrigerator"
	depends on BR2_PACKAGE_QT5
	depends on BR2_PACKAGE_QT5QUICK1D
	depends on BR2_PACKAGE_QT5WEBKIT
	depends on BR2_PACKAGE_LIBV4L
	help
	  Smart refrigerator demo.
```

## package/spacetouch/Config.in
```kconfig
config BR2_PACKAGE_SPACETOUCH
	bool "Spacetouch Qt Parallax App"
	depends on BR2_PACKAGE_QT5
	depends on BR2_PACKAGE_LIBPLANES
	help
	  Spacetouch Qt 3D Parallax effect demo application.
```

## package/uart_brk_ioctl/Config.in
```kconfig
config BR2_PACKAGE_UART_BRK_IOCTL
	bool "UART Break IOCTL utility"
	help
	  WILC3000 BLE uart break ioctl utility for PS. UART flow control
	  should be enabled to hold back HOST from sending new commmands to
	  WILC3000 BLE controller when in sleep mode.
```

## package/udmabuf/Config.in
```kconfig
config BR2_PACKAGE_UDMABUF
    bool "udmabuf kernel module"
    depends on BR2_LINUX_KERNEL
    help
      User space mappable DMA buffer device driver for Linux.

      This package builds the udmabuf kernel module from:
      https://github.com/ikwzm/udmabuf
```

## package/video-capture-at91/Config.in
```kconfig
config BR2_PACKAGE_VIDEO_CAPTURE_AT91
	bool "video-capture-at91"
	help
	  This package is a collection of scripts to configure and initialize
	  the image capture pipeline on different AT91 MPU products.

if BR2_PACKAGE_VIDEO_CAPTURE_AT91
config BR2_PACKAGE_VIDEO_CAPTURE_AT91_PLATFORM
	string "platform name"
	help
	  Available platforms: sama7g5
endif
```

## package/videoplayer/Config.in
```kconfig
config BR2_PACKAGE_VIDEOPLAYER
	bool "Video Player"
	depends on BR2_PACKAGE_QT5
	depends on BR2_PACKAGE_GSTREAMER1
	depends on BR2_PACKAGE_GST1_AT91
	depends on BR2_PACKAGE_LIBPLANES
	help
	  Video player application.
```

## package/vision/Config.in
```kconfig
config BR2_PACKAGE_VISION
	bool "Vision Demo Application"
	depends on BR2_PACKAGE_PYTHON_PYQT5
	depends on BR2_PACKAGE_OPENCV3
	depends on BR2_PACKAGE_PYTHON_SETUPTOOLS
	help
	  OpenCV machine vision demo application.
```

## package/websocket/Config.in
```kconfig
config BR2_PACKAGE_WEBSOCKET
	bool "web-socket"
	help
	  custom web socket utility
```

## package/whiteboard/Config.in
```kconfig
config BR2_PACKAGE_WHITEBOARD
	bool "Whiteboard App"
	depends on BR2_PACKAGE_QT5
	help
	  Whiteboard touchscreen demo application.
```

## package/wifi_capi/Config.in
```kconfig
config BR2_PACKAGE_WIFI_CAPI
        bool "WiFi CAPI Agent"
        help
          Control agents are a proxy in which a CAPI control command is converted for the device into the device’s native control interface. 
	  APs, DUTs, sniffers, and STAs may require control agents. 
	  Sample control agent code can be downloaded through the open source repository ( Windows or Linux ) or by members in the most recent Wi-Fi Test Suite package .
	  https://github.com/Wi-FiTestSuite/Wi-FiTestSuite-Linux-DUT
```

## package/wilc_firmware/Config.in
```kconfig
config BR2_PACKAGE_WILC_FIRMWARE
	bool "Microchip WILC devices firmware"
	help
	  Microchip WILC devices firmware files for use with Linux kernel.
```

## package/wilcbtapps/Config.in
```kconfig
config BR2_PACKAGE_WILCBTAPPS
	bool "BLE Transparent and WiFiProv GATT Service"
	select BR2_PACKAGE_BLUEZ5_UTILS
	help
	   It will compile and install the transparant service and wifi bt provisioning gatt services
```
