## configs/sama7g5ek_headless_defconfig
```kconfig
BR2_arm=y
BR2_cortex_a7=y
BR2_ARM_FPU_NEON_VFPV4=y
BR2_OPTIMIZE_FAST=y
BR2_GLOBAL_PATCH_DIR="$(BR2_EXTERNAL_MCHP_PATH)/patches"
BR2_TOOLCHAIN_BUILDROOT_GLIBC=y
BR2_PACKAGE_HOST_LINUX_HEADERS_CUSTOM_5_15=y
BR2_TOOLCHAIN_BUILDROOT_CXX=y
BR2_PACKAGE_HOST_GDB=y
BR2_PACKAGE_HOST_GDB_TUI=y
BR2_PACKAGE_HOST_GDB_PYTHON3=y
BR2_PACKAGE_HOST_GDB_SIM=y
BR2_TARGET_GENERIC_HOSTNAME="sama7"
BR2_TARGET_GENERIC_ISSUE="Welcome to the Microchip SAMA7G5 Demo"
BR2_ROOTFS_DEVICE_CREATION_DYNAMIC_EUDEV=y
BR2_SYSTEM_DHCP="eth0"
BR2_ROOTFS_OVERLAY="$(BR2_EXTERNAL_MCHP_PATH)/board/microchip/sama5/fs-overlay/"
BR2_ROOTFS_POST_IMAGE_SCRIPT="support/scripts/genimage.sh"
BR2_ROOTFS_POST_SCRIPT_ARGS="-c $(BR2_EXTERNAL_MCHP_PATH)/board/microchip/sama7g5ek/genimage.cfg"
BR2_LINUX_KERNEL=y
BR2_LINUX_KERNEL_CUSTOM_GIT=y
BR2_LINUX_KERNEL_CUSTOM_REPO_URL="https://github.com/linux4microchip/linux.git"
BR2_LINUX_KERNEL_CUSTOM_REPO_VERSION="linux-5.15-mchp"
BR2_LINUX_KERNEL_DEFCONFIG="sama7"
BR2_LINUX_KERNEL_DTS_SUPPORT=y
BR2_LINUX_KERNEL_INTREE_DTS_NAME="at91-sama7g5ek"
BR2_PACKAGE_LINUX_TOOLS_IIO=y
BR2_PACKAGE_BUSYBOX_SHOW_OTHERS=y
BR2_PACKAGE_ALSA_UTILS=y
BR2_PACKAGE_ALSA_UTILS_ALSACONF=y
BR2_PACKAGE_ALSA_UTILS_ACONNECT=y
BR2_PACKAGE_ALSA_UTILS_AMIXER=y
BR2_PACKAGE_ALSA_UTILS_APLAY=y
BR2_PACKAGE_ALSA_UTILS_SPEAKER_TEST=y
BR2_PACKAGE_ATEST=y
BR2_PACKAGE_FFMPEG_GPL=y
BR2_PACKAGE_FFMPEG_NONFREE=y
BR2_PACKAGE_FFMPEG_FFPLAY=y
BR2_PACKAGE_FFMPEG_FFPROBE=y
BR2_PACKAGE_FFMPEG_ENCODERS="jpeg mjpeg png mpeg4"
BR2_PACKAGE_FFMPEG_DECODERS="mpeg1 mpeg2 mpeg4 vp6 vp8 vp9 h264 h263 jpeg mjpeg aac vorbis mp3 rawvideo"
BR2_PACKAGE_FFMPEG_MUXERS="avi mv4 h263 h264 mp4 mp3 mp2 mov mpjeg mpeg2video mpegts image2 rawvideo"
BR2_PACKAGE_FFMPEG_DEMUXERS="avi matroska mpegts mjpeg mp3 mov mpegps mpegvideo aac h263 h264 m4v rawvideo"
BR2_PACKAGE_FFMPEG_PARSERS="h263 h264 mjpeg mpeg4video mpegvideo mpegaudio vp8 vp9 jpeg aac vorbis"
BR2_PACKAGE_FFMPEG_BSFS=""
BR2_PACKAGE_FFMPEG_PROTOCOLS="file"
BR2_PACKAGE_FFMPEG_FILTERS="scale"
BR2_PACKAGE_GSTREAMER1=y
BR2_PACKAGE_GST1_PLUGINS_BASE_PLUGIN_AUDIOMIXER=y
BR2_PACKAGE_GST1_PLUGINS_BASE_PLUGIN_AUDIORATE=y
BR2_PACKAGE_GST1_PLUGINS_BASE_PLUGIN_AUDIOTESTSRC=y
BR2_PACKAGE_GST1_PLUGINS_BASE_PLUGIN_COMPOSITOR=y
BR2_PACKAGE_GST1_PLUGINS_BASE_PLUGIN_ENCODING=y
BR2_PACKAGE_GST1_PLUGINS_BASE_PLUGIN_VIDEOCONVERT=y
BR2_PACKAGE_GST1_PLUGINS_BASE_PLUGIN_RAWPARSE=y
BR2_PACKAGE_GST1_PLUGINS_BASE_PLUGIN_SUBPARSE=y
BR2_PACKAGE_GST1_PLUGINS_BASE_PLUGIN_TCP=y
BR2_PACKAGE_GST1_PLUGINS_BASE_PLUGIN_VIDEOTESTSRC=y
BR2_PACKAGE_GST1_PLUGINS_BASE_PLUGIN_VIDEORATE=y
BR2_PACKAGE_GST1_PLUGINS_BASE_PLUGIN_ALSA=y
BR2_PACKAGE_GST1_PLUGINS_BASE_PLUGIN_OGG=y
BR2_PACKAGE_GST1_PLUGINS_BASE_PLUGIN_THEORA=y
BR2_PACKAGE_GST1_PLUGINS_BASE_PLUGIN_VORBIS=y
BR2_PACKAGE_GST1_PLUGINS_BAYER2RGB_NEON=y
BR2_PACKAGE_GST1_PLUGINS_GOOD=y
BR2_PACKAGE_GST1_PLUGINS_GOOD_JPEG=y
BR2_PACKAGE_GST1_PLUGINS_GOOD_PNG=y
BR2_PACKAGE_GST1_PLUGINS_GOOD_BZ2=y
BR2_PACKAGE_GST1_PLUGINS_GOOD_PLUGIN_AUTODETECT=y
BR2_PACKAGE_GST1_PLUGINS_GOOD_PLUGIN_FLV=y
BR2_PACKAGE_GST1_PLUGINS_GOOD_PLUGIN_MATROSKA=y
BR2_PACKAGE_GST1_PLUGINS_GOOD_PLUGIN_MULTIFILE=y
BR2_PACKAGE_GST1_PLUGINS_GOOD_PLUGIN_RTP=y
BR2_PACKAGE_GST1_PLUGINS_GOOD_PLUGIN_RTPMANAGER=y
BR2_PACKAGE_GST1_PLUGINS_GOOD_PLUGIN_RTSP=y
BR2_PACKAGE_GST1_PLUGINS_GOOD_PLUGIN_UDP=y
BR2_PACKAGE_GST1_PLUGINS_GOOD_PLUGIN_VIDEOFILTER=y
BR2_PACKAGE_GST1_PLUGINS_GOOD_PLUGIN_VIDEOMIXER=y
BR2_PACKAGE_GST1_PLUGINS_GOOD_PLUGIN_MPG123=y
BR2_PACKAGE_GST1_PLUGINS_GOOD_PLUGIN_V4L2=y
BR2_PACKAGE_GST1_PLUGINS_GOOD_PLUGIN_PULSE=y
BR2_PACKAGE_GST1_PLUGINS_BAD=y
BR2_PACKAGE_GST1_PLUGINS_BAD_PLUGIN_AUTOCONVERT=y
BR2_PACKAGE_GST1_PLUGINS_BAD_PLUGIN_BAYER=y
BR2_PACKAGE_GST1_PLUGINS_BAD_PLUGIN_SDP=y
BR2_PACKAGE_GST1_PLUGINS_BAD_PLUGIN_VIDEOPARSERS=y
BR2_PACKAGE_GST1_PLUGINS_BAD_PLUGIN_BLUEZ=y
BR2_PACKAGE_GST1_PLUGINS_BAD_PLUGIN_BZ2=y
BR2_PACKAGE_GST1_PLUGINS_BAD_PLUGIN_CURL=y
BR2_PACKAGE_GST1_PLUGINS_BAD_PLUGIN_FBDEV=y
BR2_PACKAGE_GST1_PLUGINS_BAD_PLUGIN_OPENJPEG=y
BR2_PACKAGE_GST1_PLUGINS_UGLY=y
BR2_PACKAGE_GST1_PLUGINS_UGLY_PLUGIN_MPEG2DEC=y
BR2_PACKAGE_GST1_PLUGINS_UGLY_PLUGIN_X264=y
BR2_PACKAGE_GST1_LIBAV=y
BR2_PACKAGE_V4L2GRAB=y
BR2_PACKAGE_YAVTA=y
BR2_PACKAGE_GZIP=y
BR2_PACKAGE_UNZIP=y
BR2_PACKAGE_BONNIE=y
BR2_PACKAGE_COREMARK=y
BR2_PACKAGE_DHRYSTONE=y
BR2_PACKAGE_GDB=y
BR2_PACKAGE_GDB_SERVER=y
BR2_PACKAGE_GDB_DEBUGGER=y
BR2_PACKAGE_IOZONE=y
BR2_PACKAGE_LMBENCH=y
BR2_PACKAGE_MEMSTAT=y
BR2_PACKAGE_RAMSPEED=y
BR2_PACKAGE_STRACE=y
BR2_PACKAGE_STRESS_NG=y
BR2_PACKAGE_TINYMEMBENCH=y
BR2_PACKAGE_TRACE_CMD=y
BR2_PACKAGE_WHETSTONE=y
BR2_PACKAGE_GREP=y
BR2_PACKAGE_SED=y
BR2_PACKAGE_TREE=y
BR2_PACKAGE_DOSFSTOOLS=y
BR2_PACKAGE_DOSFSTOOLS_FATLABEL=y
BR2_PACKAGE_DOSFSTOOLS_FSCK_FAT=y
BR2_PACKAGE_DOSFSTOOLS_MKFS_FAT=y
BR2_PACKAGE_E2FSPROGS=y
BR2_PACKAGE_MTD=y
BR2_PACKAGE_MTD_TESTS=y
BR2_PACKAGE_MTD_FLASH_READTEST=y
BR2_PACKAGE_MTD_FLASH_SPEED=y
BR2_PACKAGE_MTD_FLASH_STRESS=y
BR2_PACKAGE_MTD_FLASH_TORTURE=y
BR2_PACKAGE_MTD_NANDBITERRS=y
BR2_PACKAGE_MTD_NANDPAGETEST=y
BR2_PACKAGE_MTD_NANDSUBPAGETEST=y
BR2_PACKAGE_FSWEBCAM=y
BR2_PACKAGE_EVTEST=y
BR2_PACKAGE_I2C_TOOLS=y
BR2_PACKAGE_RNG_TOOLS=y
# BR2_PACKAGE_RNG_TOOLS_JITTERENTROPY_LIBRARY is not set
BR2_PACKAGE_SETSERIAL=y
BR2_PACKAGE_SPI_TOOLS=y
BR2_PACKAGE_USBUTILS=y
BR2_PACKAGE_CA_CERTIFICATES=y
BR2_PACKAGE_LIBGPIOD=y
BR2_PACKAGE_LIBGPIOD_TOOLS=y
BR2_PACKAGE_LIBINPUT=y
BR2_PACKAGE_LIBV4L_UTILS=y
BR2_PACKAGE_CJSON=y
BR2_PACKAGE_JSON_GLIB=y
BR2_PACKAGE_LIBCAMERA=y
BR2_PACKAGE_LIBCAMERA_V4L2=y
BR2_PACKAGE_LIBCAMERA_PIPELINE_SIMPLE=y
BR2_PACKAGE_LIBCAMERA_PIPELINE_UVCVIDEO=y
BR2_PACKAGE_C_ARES=y
BR2_PACKAGE_LIBCURL_CURL=y
BR2_PACKAGE_NGHTTP2=y
BR2_PACKAGE_LIBUV=y
BR2_PACKAGE_BLUEZ5_UTILS_CLIENT=y
BR2_PACKAGE_BLUEZ5_UTILS_DEPRECATED=y
BR2_PACKAGE_BLUEZ5_UTILS_EXPERIMENTAL=y
BR2_PACKAGE_BLUEZ5_UTILS_PLUGINS_HEALTH=y
BR2_PACKAGE_BLUEZ5_UTILS_PLUGINS_MIDI=y
BR2_PACKAGE_BLUEZ5_UTILS_PLUGINS_NFC=y
BR2_PACKAGE_BLUEZ5_UTILS_PLUGINS_SAP=y
BR2_PACKAGE_BLUEZ5_UTILS_TEST=y
BR2_PACKAGE_BRIDGE_UTILS=y
BR2_PACKAGE_CAN_UTILS=y
BR2_PACKAGE_CRDA=y
BR2_PACKAGE_DHCP=y
BR2_PACKAGE_DHCP_SERVER=y
BR2_PACKAGE_DHCP_RELAY=y
BR2_PACKAGE_DROPBEAR=y
BR2_PACKAGE_DROPBEAR_DISABLE_REVERSEDNS=y
BR2_PACKAGE_ETHTOOL=y
BR2_PACKAGE_HOSTAPD=y
BR2_PACKAGE_HOSTAPD_EAP=y
BR2_PACKAGE_HOSTAPD_WPS=y
BR2_PACKAGE_IFUPDOWN=y
BR2_PACKAGE_IPERF3=y
BR2_PACKAGE_IPROUTE2=y
BR2_PACKAGE_IPTABLES=y
BR2_PACKAGE_IPUTILS=y
BR2_PACKAGE_IW=y
BR2_PACKAGE_LINUXPTP=y
BR2_PACKAGE_LRZSZ=y
BR2_PACKAGE_MII_DIAG=y
BR2_PACKAGE_NET_TOOLS=y
BR2_PACKAGE_NETCAT=y
BR2_PACKAGE_NFTABLES=y
BR2_PACKAGE_NMAP=y
BR2_PACKAGE_NMAP_NCAT=y
BR2_PACKAGE_NMAP_NPING=y
BR2_PACKAGE_NTP=y
BR2_PACKAGE_NTP_NTPDATE=y
BR2_PACKAGE_NTP_NTPDC=y
BR2_PACKAGE_OPENSSH=y
BR2_PACKAGE_PHYTOOL=y
BR2_PACKAGE_PTPD2=y
BR2_PACKAGE_RADVD=y
BR2_PACKAGE_RSYNC=y
BR2_PACKAGE_TCPDUMP=y
BR2_PACKAGE_TRACEROUTE=y
BR2_PACKAGE_UDPCAST=y
BR2_PACKAGE_UDPCAST_SENDER=y
BR2_PACKAGE_WGET=y
BR2_PACKAGE_WIRELESS_TOOLS=y
BR2_PACKAGE_WPA_SUPPLICANT=y
BR2_PACKAGE_WPA_SUPPLICANT_AP_SUPPORT=y
BR2_PACKAGE_BASH=y
BR2_PACKAGE_BASH_COMPLETION=y
BR2_PACKAGE_FILE=y
BR2_PACKAGE_TIME=y
BR2_PACKAGE_WHICH=y
BR2_PACKAGE_NANO=y
BR2_PACKAGE_VIM=y
BR2_TARGET_ROOTFS_EXT2=y
BR2_TARGET_ROOTFS_EXT2_4=y
BR2_TARGET_ROOTFS_EXT2_SIZE="900M"
BR2_TARGET_AT91BOOTSTRAP3=y
BR2_TARGET_AT91BOOTSTRAP3_CUSTOM_GIT=y
BR2_TARGET_AT91BOOTSTRAP3_CUSTOM_REPO_URL="https://github.com/linux4sam/at91bootstrap.git"
BR2_TARGET_AT91BOOTSTRAP3_CUSTOM_REPO_VERSION="v4.0.1"
BR2_TARGET_AT91BOOTSTRAP3_DEFCONFIG="sama7g5eksd_uboot"
BR2_TARGET_UBOOT=y
BR2_TARGET_UBOOT_BUILD_SYSTEM_KCONFIG=y
BR2_TARGET_UBOOT_CUSTOM_GIT=y
BR2_TARGET_UBOOT_CUSTOM_REPO_URL="https://github.com/linux4sam/u-boot-at91.git"
BR2_TARGET_UBOOT_CUSTOM_REPO_VERSION="linux4sam-2021.10"
BR2_TARGET_UBOOT_BOARD_DEFCONFIG="sama7g5ek_mmc1"
BR2_TARGET_UBOOT_NEEDS_DTC=y
BR2_PACKAGE_HOST_DOSFSTOOLS=y
BR2_PACKAGE_HOST_GENIMAGE=y
BR2_PACKAGE_HOST_MTOOLS=y
BR2_PACKAGE_HOST_UBOOT_TOOLS=y
BR2_PACKAGE_HOST_UBOOT_TOOLS_FIT_SUPPORT=y
BR2_PACKAGE_HOST_UBOOT_TOOLS_ENVIMAGE=y
BR2_PACKAGE_HOST_UBOOT_TOOLS_ENVIMAGE_SOURCE="$(BR2_EXTERNAL_MCHP_PATH)/board/microchip/sama7g5ek/uboot-env.txt"
BR2_PACKAGE_HOST_UBOOT_TOOLS_ENVIMAGE_SIZE="0x4000"
BR2_PACKAGE_DT_OVERLAY_AT91=y
BR2_PACKAGE_DT_OVERLAY_AT91_PLATFORM="sama7g5ek"
BR2_PACKAGE_WILC_FIRMWARE=y
BR2_PACKAGE_VIDEO_CAPTURE_AT91=y
BR2_PACKAGE_VIDEO_CAPTURE_AT91_PLATFORM="sama7g5"
```

## package/9bit/Config.in
```kconfig
config BR2_PACKAGE_9BIT
	bool "Microchip SAMA5 9-bit/Multidrop Serial Mode"
	help
	  This repositories contains some examples to work with and evaluate 9-bit UART solutions on Microchip SAMA5 processors.
	  Some processors support hardware 9-bit mode and features surrounding this mode, and some do not.
	  However, even in those cases it is still possible to make use of 9-bit mode.
	  In all cases, the Linux kernel API does not provide a standard way of using all of the necessary features.
```

## package/ble-bluez-hci-apps/Config.in
```kconfig
config BR2_PACKAGE_BLE_BLUEZ_HCI_APPS
	bool "Microchip bluez ble sw apps"
	select BR2_PACKAGE_BLUEZ5_UTILS
	select BR2_PACKAGE_BLUEZ5_UTILS_HEADERS
	help
	  Enable ble-uart-bluez and dfu-bluez tools.
```

## package/browser/Config.in
```kconfig
config BR2_PACKAGE_BROWSER
	bool "QML Web Browser"
	depends on BR2_PACKAGE_QT5
	depends on BR2_PACKAGE_QT5QUICK1D
	depends on BR2_PACKAGE_QT5WEBKIT
	help
	  QML web browser.
```

## package/cryptoauthlib/Config.in
```kconfig
config BR2_PACKAGE_CRYPTOAUTHLIB
	bool "cryptoauthlib"
	depends on !BR2_STATIC_LIBS
	depends on BR2_USE_MMU
	depends on BR2_TOOLCHAIN_HAS_THREADS
	help
      Use cryptoauthlib as a pkcs11 provider.

      https://github.com/MicrochipTech/cryptoauthlib/blob/pkcs11/app/pkcs11/README.md

if BR2_PACKAGE_CRYPTOAUTHLIB
choice
	prompt "Select the board on which ECCX08 will reside"

config BR2_PACKAGE_CRYPTOAUTHLIB_SAMA5D27_SOM1_EK
	bool "sama5d27_som1_ek"

config BR2_PACKAGE_CRYPTOAUTHLIB_SAMA5D27_WLSOM1_EK
	bool "sama5d27_wlsom1_ek"

config BR2_PACKAGE_CRYPTOAUTHLIB_SAMA5D29_CURIOSITY
	bool "sama5d29_curiosity"

config BR2_PACKAGE_CRYPTOAUTHLIB_SAMA5D2_ICP
	bool "sama5d2_icp"

config BR2_PACKAGE_CRYPTOAUTHLIB_SAMA5D2_PTC_EK
	bool "sama5d2_ptc_ek"

config BR2_PACKAGE_CRYPTOAUTHLIB_SAMA5D2_XPLAINED
	bool "sama5d2_xplained"

config BR2_PACKAGE_CRYPTOAUTHLIB_SAMA7G5EK
	bool "sama7g5ek"

config BR2_PACKAGE_CRYPTOAUTHLIB_SAM9X60EK
	bool "sam9x60ek"

config BR2_PACKAGE_CRYPTOAUTHLIB_SAM9X60_CURIOSITY
	bool "sam9x60_curiosity"

config BR2_PACKAGE_CRYPTOAUTHLIB_SAM9X75_CURIOSITY
	bool "sam9x75_curiosity"

config BR2_PACKAGE_CRYPTOAUTHLIB_AT91SAM9X5EK
	bool "at91sam9x5ek"

config BR2_PACKAGE_CRYPTOAUTHLIB_SAMA5D3_EDS
	bool "sama5d3_eds"

config BR2_PACKAGE_CRYPTOAUTHLIB_SAMA5D3_XPLAINED
	bool "sama5d3_xplained"

config BR2_PACKAGE_CRYPTOAUTHLIB_SAMA5D4_XPLAINED
	bool "sama5d4_xplained"

endchoice
endif
```

## package/dt-overlay-at91/Config.in
```kconfig
config BR2_PACKAGE_DT_OVERLAY_AT91
	bool "dt-overlay-at91"
	help
	  This package contains DT overlays files (dtso) for Microchip
	  platforms plus its files to generate FIT images.

if BR2_PACKAGE_DT_OVERLAY_AT91
config BR2_PACKAGE_DT_OVERLAY_AT91_PLATFORM
	string "platform name"
	help
	  Available platforms: at91sam9x5ek, sama5d27_som1_ek,
	  sama5d2_ptc_ek, sama5d2_xplained, sama5d3_xplained,
	  sama5d4_xplained, sam9x60ek.

choice
	prompt "output"
	default BR2_PACKAGE_DT_OVERLAY_AT91_FIT
	help
	  Build only the device tree overlays or build them and embed
	  them in a FIT image.

config BR2_PACKAGE_DT_OVERLAY_AT91_ONLY
	bool "dtbos only"

config BR2_PACKAGE_DT_OVERLAY_AT91_FIT
	bool "FIT image"
endchoice
endif
```

## package/dt-overlay-mchp/Config.in
```kconfig
config BR2_PACKAGE_DT_OVERLAY_MCHP
	bool "dt-overlay-mchp"
	help
	  This package contains DT overlays files (dtso) for Microchip
	  platforms plus its files to generate FIT images.

if BR2_PACKAGE_DT_OVERLAY_MCHP
config BR2_PACKAGE_DT_OVERLAY_MCHP_PLATFORM
	string "platform name"
	help
	  Available platforms: at91sam9x5ek, mpfs_icicle,
	  mpfs_icicle_amp, pic64gx_curiosity_kit, sama5d27_som1_ek,
	  sama5d27_wlsom1_ek, sama5d29_curiosity, sama5d2_ptc_ek,
	  sama5d2_xplained, sama5d3_eds, sama5d3_xplained,
	  sama5d4_xplained, sam9x60ek, sam9x60_curiosity,
	  sam9x75_curiosity, sama7g54_curiosity.

choice
	prompt "output"
	default BR2_PACKAGE_DT_OVERLAY_MCHP_FIT
	help
	  Build only the device tree overlays or build them and embed
	  them in a FIT image.

config BR2_PACKAGE_DT_OVERLAY_MCHP_ONLY
	bool "dtbos only"

config BR2_PACKAGE_DT_OVERLAY_MCHP_FIT
	bool "FIT image"
endchoice
endif
```
